## drivers/ptp_clock/Kconfig.dwmac
```kconfig
# SPDX-License-Identifier: Apache-2.0

config PTP_CLOCK_DWMAC
	bool "Synopsys DesignWare MAC PTP Clock driver"
	default y
	depends on DT_HAS_SNPS_DWMAC_PTP_CLOCK_ENABLED && NET_L2_PTP
	depends on ETH_DWMAC
	help
	  Enable Synopsys DesignWare MAC PTP clock support.
	  
	  This driver provides PTP (Precision Time Protocol) clock support
	  for Synopsys DesignWare MAC controllers. It enables timestamp
	  capabilities for precision time synchronization.
```

## dts/bindings/ethernet/ethernet-controller.yaml
```yaml
# Copyright (c) 2018, Linaro Limited
# SPDX-License-Identifier: Apache-2.0

# Common fields for Ethernet devices

include:
  - name: base.yaml
  - name: ethernet-mac-address.yaml

properties:
  phy-handle:
    type: phandle
    dependency-mode: reverse
    description: |
      Specifies a reference to a node representing a PHY device.
      The PHY device depends on the Ethernet device, so the Ethernet
      device is initialized first and can pass its link capabilities
      to the PHY with phy_set_mac_caps().

  phy-connection-type:
    type: string
    description: |
      Specifies the interface connection type between ethernet MAC and PHY.
    enum:
      - "mii"
      - "rmii"
      - "gmii"
      - "rgmii"
      - "rgmii-id"
      - "rgmii-txid"
      - "rgmii-rxid"
      - "tbi"
      - "rtbi"
      - "smii"
      - "sgmii"
      - "rev-mii"
      - "xgmii"
      - "moca"
      - "qsgmii"
      - "trgmii"
      - "internal"

  ptp-clock:
    type: phandle
    description: |
      Corresponding ptp clock device.
```

## dts/bindings/ethernet/snps,dwmac-ptp-clock.yaml
```yaml
# SPDX-License-Identifier: Apache-2.0

description: Synopsys DesignWare MAC PTP (Precision Time Protocol) Clock

compatible: "snps,dwmac-ptp-clock"

include: ["base.yaml"]

properties:
  reg:
    description: PTP clock register base address and size (optional, inherited from parent)
```

## dts/bindings/usb/st,stm32mp1-hsotg.yaml
```yaml
# SPDX-FileCopyrightText: Copyright The Zephyr Project Contributors
# SPDX-License-Identifier: Apache-2.0

description: |
  STM32MP1 OTG DWC2 compatible controller.

  The controller is connected to port 1 of the USBPHYC USB HS PHY and is
  clocked by the 48 MHz clock generated by the PHY.

compatible: "st,stm32mp1-hsotg"

include: ["snps,dwc2.yaml", reset-device.yaml]

properties:
  clocks:
    required: true
    description: Bus clock of the controller.

  resets:
    required: true
    description: Reset line of the controller.

  phys:
    required: true
    description: USBPHYC port the controller is connected to.
```

## soc/aesc/hydrogen/Kconfig
```kconfig
# SPDX-FileCopyrightText: 2026 Aesc Silicon
# SPDX-License-Identifier: Apache-2.0

config SOC_SERIES_HYDROGEN
	select RISCV
	select RISCV_SOC_COMMON_PRIVILEGED
	select INCLUDE_RESET_VECTOR
	select PINCTRL
	select CLOCK_CONTROL

config SOC_PART_NUMBER
	default "elemrv_h" if SOC_ELEMRV_H
```

## soc/aesc/hydrogen/Kconfig.defconfig
```kconfig
# SPDX-FileCopyrightText: 2026 Aesc Silicon
# SPDX-License-Identifier: Apache-2.0

if SOC_SERIES_HYDROGEN

config RISCV_SOC_INTERRUPT_INIT
	default y

config 2ND_LVL_ISR_TBL_OFFSET
	default 12

config 2ND_LVL_INTR_00_OFFSET
	default 11

config MAX_IRQ_PER_AGGREGATOR
	default 52

config NUM_IRQS
	default 32

config XIP
	default y

config USE_DT_CODE_PARTITION
	default y

# syscon provides the reference clock for the clock controller, so it must
# initialize before CLOCK_CONTROL_INIT_PRIORITY (KERNEL_INIT_PRIORITY_OBJECTS).
config SYSCON_INIT_PRIORITY
	default 20

endif # SOC_SERIES_HYDROGEN
```

## soc/aesc/nitrogen/Kconfig.defconfig
```kconfig
# SPDX-FileCopyrightText: 2025 Aesc Silicon
# SPDX-License-Identifier: Apache-2.0

if SOC_SERIES_NITROGEN

config RISCV_SOC_INTERRUPT_INIT
	default y

config 2ND_LVL_ISR_TBL_OFFSET
	default 12

config 2ND_LVL_INTR_00_OFFSET
	default 11

config XIP
	default n

if SOC_ELEMRV_N

config NUM_IRQS
	default 32

endif # SOC_ELEMRV_N

endif # SOC_SERIES_NITROGEN
```

## soc/andestech/ae350/Kconfig
```kconfig
# Copyright (c) 2021 Andes Technology Corporation
# SPDX-License-Identifier: Apache-2.0

config SOC_SERIES_AE350
	select RISCV
	select RISCV_PRIVILEGED
	select RISCV_PMP
	select RISCV_SOC_HAS_GP_RELATIVE_ADDRESSING
	select CPU_HAS_DCACHE
	select CPU_HAS_ICACHE
	select CPU_HAS_ANDES_EXECIT
	select CPU_HAS_ANDES_HWDSP
	select CPU_HAS_ANDES_PFT
	select CPU_HAS_ANDES_PMA
	select CPU_HAS_ANDES_HSP
	select RISCV_SOC_CONTEXT_SAVE if RISCV_CUSTOM_CSR_ANDES_HWDSP
	select RISCV_SOC_CONTEXT_SAVE if RISCV_CUSTOM_CSR_ANDES_PFT
	select SOC_EARLY_INIT_HOOK if RISCV_CUSTOM_CSR_ANDES_PMA
	select SOC_PER_CORE_INIT_HOOK if RISCV_CUSTOM_CSR_ANDES_PMA
	imply XIP

if SOC_SERIES_AE350

config SOC_ANDES_V5_IOCP
	bool "Andes V5 I/O Coherence Port (IOCP)"
	depends on DCACHE
	help
	  Support Andes V5 I/O Coherence Port to handle cache coherency between cache and external
	  non-caching master, such as DMA controller.

endif # SOC_SERIES_AE350
```

## soc/cdac/thejas32/Kconfig
```kconfig
# Copyright (c) 2026 Anuj Deshpande
# SPDX-License-Identifier: Apache-2.0

config SOC_THEJAS32
	select RISCV
	select RISCV_SOC_COMMON_PRIVILEGED
	select INCLUDE_RESET_VECTOR
	select RISCV_SOC_INTERRUPT_INIT
	select ATOMIC_OPERATIONS_C
	help
	  Enable support for the C-DAC THEJAS32 SoC.

	  THEJAS32 is built around the VEGA ET1031, a 32-bit (RV32IM) single-core,
	  in-order, 3-stage pipeline RISC-V processor designed by C-DAC as part of
	  India's Digital India RISC-V (DIR-V) programme. The image is loaded into
	  and executed from internal SRAM, so execute-in-place (XIP) is not used.

	  The SoC follows the RISC-V privileged specification, with a custom
	  (non-PLIC) interrupt controller behind the machine external interrupt
	  line whose driver implements the generic riscv_ext_irq interface.
```

## soc/common/Kconfig
```kconfig
# Copyright (c) 2024 Nordic Semiconductor ASA
# SPDX-License-Identifier: Apache-2.0

if RISCV_SOC_COMMON_PRIVILEGED

rsource "riscv-privileged/Kconfig"

endif # RISCV_SOC_COMMON_PRIVILEGED
```

## soc/efinix/sapphire/Kconfig
```kconfig
# Copyright (c) 2023 Efinix Inc.
# SPDX-License-Identifier: Apache-2.0

config SOC_EFINIX_SAPPHIRE
	select INCLUDE_RESET_VECTOR
	select RISCV
	select RISCV_SOC_COMMON_PRIVILEGED
	imply XIP
```

## soc/intel/intel_niosv/niosv/Kconfig.defconfig.series
```kconfig
# Copyright (C) 2023-2024, Intel Corporation
#
# SPDX-License-Identifier: Apache-2.0

if SOC_SERIES_NIOSV

config NUM_IRQS # Platform interrupts IRQs index start from index 16
	default 32

config RISCV_SOC_INTERRUPT_INIT
	default y

endif # SOC_SERIES_NIOSV
```

## soc/litex/litex_vexiiriscv/Kconfig
```kconfig
# SPDX-FileCopyrightText: Copyright The Zephyr Project Contributors
# SPDX-License-Identifier: Apache-2.0

config SOC_LITEX_VEXIIRISCV
	select RISCV
	select INCLUDE_RESET_VECTOR
	select RISCV_SOC_COMMON_PRIVILEGED
	select RISCV_SOC_HAS_GP_RELATIVE_ADDRESSING
```

## soc/litex/litex_vexriscv/Kconfig
```kconfig
# SPDX-FileCopyrightText: Copyright (c) 2018 - 2019 Antmicro <www.antmicro.com>
# SPDX-License-Identifier: Apache-2.0

config SOC_LITEX_VEXRISCV
	select RISCV
	select INCLUDE_RESET_VECTOR
```

## soc/renode/riscv_virtual/Kconfig
```kconfig
# Copyright (c) 2023 Meta
# SPDX-License-Identifier: Apache-2.0

config SOC_RISCV_VIRTUAL_RENODE
	select RISCV
	select INCLUDE_RESET_VECTOR
	select RISCV_SOC_HAS_GP_RELATIVE_ADDRESSING
	imply XIP
```

## soc/wch/ch32v/ch32h41x/Kconfig.defconfig
```kconfig
# Copyright (c) 2026 Liu Changjie
# SPDX-License-Identifier: Apache-2.0

if SOC_SERIES_CH32H41X

config CLOCK_CONTROL
	default y if !SOC_CH32H417_V3F

rsource "Kconfig.defconfig.*"

endif # SOC_SERIES_CH32H41X
```

## soc/wch/ch32v/qingke_v2c/Kconfig.defconfig
```kconfig
# Copyright (c) 2025 Michael Hope <michaelh@juju.nz>
# SPDX-License-Identifier: Apache-2.0

if SOC_SERIES_QINGKE_V2C

config CLOCK_CONTROL
	default y

rsource "Kconfig.defconfig.*"

endif # SOC_SERIES_QINGKE_V2C
```

## soc/wch/ch32v/qingke_v3a/Kconfig.defconfig
```kconfig
# Copyright (c) 2026 Lucy Wong
# SPDX-License-Identifier: Apache-2.0

if SOC_SERIES_QINGKE_V3A

config CLOCK_CONTROL
	default y

rsource "Kconfig.defconfig.*"

endif # SOC_SERIES_QINGKE_V3A
```

## soc/wch/ch32v/qingke_v3c/Kconfig.defconfig
```kconfig
# SPDX-FileCopyrightText: 2026 SMILE (smile.eu)
# SPDX-License-Identifier: Apache-2.0

if SOC_SERIES_QINGKE_V3C

rsource "Kconfig.defconfig.*"

endif # SOC_SERIES_QINGKE_V3C
```

## soc/wch/ch32v/qingke_v4b/Kconfig.defconfig
```kconfig
# Copyright (c) 2025 MASSDRIVER EI (massdriver.space)
# SPDX-License-Identifier: Apache-2.0

if SOC_SERIES_QINGKE_V4B

config CLOCK_CONTROL
	default y

rsource "Kconfig.defconfig.*"

endif # SOC_SERIES_QINGKE_V4B
```

## soc/wch/ch32v/qingke_v4f/Kconfig.defconfig
```kconfig
# Copyright (c) 2025 Bootlin
# SPDX-License-Identifier: Apache-2.0

if SOC_SERIES_QINGKE_V4F

config CLOCK_CONTROL
	default y

rsource "Kconfig.defconfig.*"

endif # SOC_SERIES_QINGKE_V4F
```
