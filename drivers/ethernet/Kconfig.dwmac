## drivers/ethernet/Kconfig.dwmac
```kconfig
# Synopsys DesignWare MAC configuration options

# Copyright (c) 2021 BayLibre SAS
# SPDX-License-Identifier: Apache-2.0

menu "Synopsys DesignWare MAC driver"

config ETH_DWMAC
	bool
	depends on NET_BUF_FIXED_DATA_SIZE
	help
	  This is a driver for the Synopsys DesignWare MAC, also referred to
	  as "DesignWare Cores Ethernet Quality-of-Service". Hardware versions
	  4.x and 5.x are supported.

	  Platform specific glue support is also required. This driver is
	  currently available on STM32 targets (as an alternative to the
	  eth_stm32_hal driver). Support for a generic DT and MMU based
	  platform is also provided.

	  Not yet implemented:
	  - PTP support
	  - VLAN support
	  - various hardware offloads (when available)

config ETH_DWMAC_STM32
	bool "Synopsys DesignWare MAC driver for STM32 series"
	depends on !ETH_STM32_HAL
	depends on SOC_SERIES_STM32H5X \
		   || SOC_SERIES_STM32H7X \
		   || SOC_SERIES_STM32H7RSX \
		   || SOC_SERIES_STM32MP13X \
		   || SOC_SERIES_STM32N6X
	depends on DT_HAS_ST_STM32_ETHERNET_ENABLED
	select ETH_DWMAC
	select NOCACHE_MEMORY if ARCH_HAS_NOCACHE_MEMORY_SUPPORT
	select PINCTRL
	select HWINFO
	select CRC
	default y
	help
	  This enables the Synopsys DesignWare MAC driver on STM32 SoCs that
	  integrate a Synopsys DesignWare Ethernet MAC (DWMAC/DWC EthernetQoS).

	  Supported STM32 series:
	    - STM32H5X  (H563/H573)   - SBS ETH MII/RMII selection
	    - STM32H7X  (H743/H753/H735/H750) - SYSCFG ETH MII/RMII selection
	    - STM32H7RSX (H7S7/H7R7)  - SBS ETH PHYSEL selection
	    - STM32MP13X (MP135)       - SYSCFG ETH MII/RMII selection
	    - STM32N6X  (N657)         - SBS ETH MII/RMII selection

	  Note: STM32F1/F2/F4/F7 integrate an older Synopsys MAC variant
	  (pre-QoS IP) that requires additional porting work in the core
	  eth_dwmac.c driver and are therefore not yet supported here.

# Backward-compatibility alias: ETH_DWMAC_STM32H7X was the previous name for
# ETH_DWMAC_STM32.  Existing board configurations that set this symbol will
# still work because selecting it also selects the new symbol.
config ETH_DWMAC_STM32H7X
	bool
	select ETH_DWMAC_STM32

config ETH_DWMAC_MMU
	bool "Synopsys DesignWare MAC driver for MMU based platforms"
	depends on MMU
	depends on DT_HAS_SNPS_DESIGNWARE_ETHERNET_ENABLED
	select ETH_DWMAC
	default y
	help
	  This enables the Synopsys DesignWare MAC driver on MMU based
	  platforms.

if ETH_DWMAC

config DWMAC_NB_TX_DESCS
	int "Number of entries in the transmit descriptor ring"
	default 16
	range 4 128
	help
	  A higher number allows for more packets to be queued which may
	  improve throughput, but that requires more transient memory.
	  However there must be enough descriptors to hold all fragments
	  of a full-size packet to be transmitted or the packet will be
	  dropped.

	  Fragment size is influenced by CONFIG_NET_BUF_DATA_SIZE.

config DWMAC_NB_RX_DESCS
	int "Number of entries in the receive descriptor ring"
	default 16
	range 4 128
	help
	  Received packets are spread across the required number of fragment
	  buffers. Each RX fragment has a size of CONFIG_NET_BUF_DATA_SIZE.
	  There is one descriptor entry per fragment.

	  A higher number allows for more packets to be received without
	  immediate intervention from the CPU but requires more transient
	  memory. A smaller number increases the risk of an overflow and
	  dropped packets.

config ETH_DWMAC_RX_REFILL_THREAD_PRIORITY
	int "Receive buffer refill thread priority"
	default 0
	help
	  Priority level of the internal thread which is used to refill
	  the receive buffer pool.

endif # ETH_DWMAC

endmenu
```

## drivers/ethernet/Kconfig.smsc91x
```kconfig
# Copyright (c) 2023 Arm Limited (or its affiliates). All rights reserved.
# SPDX-License-Identifier: Apache-2.0

config ETH_SMSC91X
	bool "SMSC91x Ethernet driver"
	default y
	depends on DT_HAS_SMSC_LAN91C111_ENABLED
	select MDIO
	help
	  Enable driver for SMSC/LAN91x family of chips.

if ETH_SMSC91X

config ETH_SMSC91X_MDIO
	bool "SMSC91x MDIO Controller"
	default y
	depends on MDIO
	select ETH_DRIVER_WITH_MDIO
	help
	  Enable integrated MDIO controller

endif # ETH_SMSC91X
```

## drivers/sdhc/Kconfig.litex
```kconfig
# Copyright The Zephyr Project Contributors
# SPDX-License-Identifier: Apache-2.0

config SDHC_LITEX_LITESDCARD
	bool "LiteX LiteSDCard SDHC driver"
	default y
	depends on DT_HAS_LITEX_LITESDCARD_SDHC_ENABLED
	select SDHC_SUPPORTS_NATIVE_MODE
	help
	  sdhc driver for LiteX LiteSDCard.

if SDHC_LITEX_LITESDCARD

config SDHC_LITEX_LITESDCARD_NO_CMD23_SET_BLOCK_COUNT
	bool "No CMD23 set block count"
	help
	  Some cards do not support CMD23 to set the block count for multiple
	  block read/write operations. Enabling this option will issue a STOP
	  TRANSMISSION command at the end of each multiple block operation.

config SDHC_LITEX_LITESDCARD_NO_COHERENT_DMA
	bool "No coherent DMA bus, need cache management"
	help
	  This needs to be enabled if the LiteSDCard Module is not connected
	  to a coherent DMA bus, meaning that the cache needs to be managed
	  before and after DMA operations.

endif # SDHC_LITEX_LITESDCARD
```

## drivers/serial/Kconfig.rpi_pico
```kconfig
# Copyright (c) 2021 Yonatan Schachter
# SPDX-License-Identifier: Apache-2.0

config UART_RPI_PICO_PIO
	bool "Raspberry Pi PIO UART driver"
	default y
	depends on DT_HAS_RASPBERRYPI_PICO_UART_PIO_ENABLED
	select SERIAL_HAS_DRIVER
	select PICOSDK_USE_PIO
	select PICOSDK_USE_CLAIM
	select PINCTRL
	select EARLY_CONSOLE_NOT_SUPPORTED
	depends on RESET
```

## dts/bindings/adc/ti,ade7913.yaml
```yaml
# SPDX-FileCopyrightText: Copyright The Zephyr Project Contributors
# SPDX-License-Identifier: Apache-2.0

description: Analog Devices ADE7913 3-channel SPI ADC

compatible: "ti,ade7913"

include: [adc-controller.yaml, spi-device.yaml]

on-bus: spi

properties:
  "#io-channel-cells":
    const: 1

io-channel-cells:
  - input
```

## dts/bindings/ethernet/st,stm32mp13-ethernet.yaml
```yaml
# Copyright (c) 2025, STMicroelectronics
# SPDX-License-Identifier: Apache-2.0

description: |
  STM32MP13 Ethernet

  This binding describes the device tree properties required to configure
  and use the Ethernet controllers on the STM32MP13 series (e.g. STM32MP135).

  The STM32MP13 integrates two independent Synopsys DWC EthernetQoS MACs:
    - ETH1 at 0x5800_A000 (SYSCFG ETH1 MII/RMII/RGMII selector)
    - ETH2 at 0x5800_E000 (SYSCFG ETH2 MII/RMII/RGMII selector)

  Both MACs support MII, RMII, and RGMII interface modes; the selected mode
  must be specified via the phy-connection-type property.

  On the STM32MP135F-DK board:
    - ETH1 is connected to a Microchip LAN8742 PHY (RMII)
    - ETH2 is connected to a Microchip KSZ9131RNX PHY (RGMII, 1 Gbps)

compatible: "st,stm32mp13-ethernet"

include:
  - "st,stm32-ethernet-common.yaml"
  - "memory-region.yaml"

properties:
  memory-regions:
    required: true
    description: |
      Memory region in which the Ethernet DMA lists and data buffers will be
      placed. The memory region has to be non-cacheable and accessible by the
      Ethernet peripheral.
  st,ext-phyclk:
    type: boolean
    description:
      Set this property in RMII mode when you have PHY without crystal 50MHz and want to
      select RCC clock instead of ETH_REF_CLK, or in RGMII mode when you want to select
      RCC clock instead of ETH_CLK125.
```

## modules/zlib/Kconfig
```kconfig
# Copyright (c) 2026
# SPDX-License-Identifier: Apache-2.0

config ZEPHYR_ZLIB_MODULE
	bool
	default y

config ZLIB_INFLATE
	bool "zlib inflate support"
	depends on ZEPHYR_TRUSTED_FIRMWARE_A_MODULE
	help
	  Build a lightweight zlib inflate implementation that can be used by
	  networking libraries for streaming decompression (for example HTTP
	  Content-Encoding: gzip).
```
